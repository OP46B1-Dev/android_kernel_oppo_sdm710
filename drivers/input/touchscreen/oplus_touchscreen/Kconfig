## drivers/input/touchscreen/oplus_touchscreen/Kconfig
```kconfig
# SPDX-License-Identifier: GPL-2.0-only
# Copyright (C) 2018-2020 Oplus. All rights reserved.

config TOUCHSCREEN_OPLUS
  bool "OPLUS tp module"
  help
    Say Y here if you have touchscreen module.

config TOUCHSCREEN_SYNAPTICS
  bool "TP Synaptics_IC enable or not for OPLUS"
  help
    say Y to enable driver for Touchpanel using Synaptics_IC

if TOUCHSCREEN_SYNAPTICS
source "drivers/input/touchscreen/oplus_touchscreen/Synaptics/Kconfig"
endif
```

## drivers/input/touchscreen/oplus_touchscreen/Synaptics/Kconfig
```kconfig
# SPDX-License-Identifier: GPL-2.0-only
# Copyright (C) 2018-2020 Oplus. All rights reserved.

source "drivers/input/touchscreen/oplus_touchscreen/Synaptics/S3706/Kconfig"
```

## drivers/input/touchscreen/oplus_touchscreen/Synaptics/S3706/Kconfig
```kconfig
# SPDX-License-Identifier: GPL-2.0-only
# Copyright (C) 2018-2020 Oplus. All rights reserved.

config TOUCHSCREEN_SYNAPTICS_S3706
  bool "TP Synaptics_S3508 IC enable or not for OPPO"
  help
	  say Y to enable driver for Touchpanel useing synaptics s3706
```

## drivers/nfc/oplus_nfc/Kconfig
```kconfig
config OPLUS_NFC
  bool "config oplus nfc chipset"
  help
	define this config to get chipset version from dts.
```

## drivers/platform/oplus/Kconfig
```kconfig
# OPlus configuration options

config MACH_OPLUS
	bool "OPlus device"
	depends on ARCH_QCOM
	help
	  Support for OPlus products

config MACH_OPLUS_SDM710
	bool "OPlus SDM710"
	depends on ARCH_QCOM
	select MACH_OPLUS
	help
	  Support for OPlus SDM710 devices

menu "OPlus board selection"

config MACH_OPLUS_OP46B1
  bool "OPPO Reno board"
  select MACH_OPLUS_SDM710
  help
    Support for OPPO Reno (OP46B1)

endmenu
```

## drivers/power/oplus/Kconfig
```kconfig
# SPDX-License-Identifier: GPL-2.0
#
# OPLUS charging stack (sdm670R / OP46B1 / SDM710 + PMI632).

config OPLUS_CHARGER
	bool "OPLUS Charger Driver (sdm670R)"
	default y
	depends on MACH_OPLUS && I2C
	select REGMAP_I2C
	select QPNP_SMB2
	help
	  This enables the OPLUS charging stack for the sdm670R platform
	  (OP46B1 / SDM710 + PMI632). It hooks into the qcom QPNP SMB2
	  charger driver via function-pointer callbacks (struct oplus_smb_hook)
	  and provides the oplus vooc / gauge / adapter / short-circuit / IC
	  (bq27541) business logic.

	  When disabled, the qcom QPNP SMB2 charger behaves exactly like the
	  upstream original (all hooks compile away to no-ops).

	  Say Y here for OP46B1 / Reno.

if OPLUS_CHARGER

config OPLUS_SDM670R_CHARGER
	bool
	default y
	help
	  Compatibility symbol used by the original sdm670R charging sources.

config OPLUS_CHIP_SOC_NODE
	bool "Expose the OPLUS chip SOC property"
	default y

config OPLUS_SHORT_C_BATT_CHECK
	bool "OPLUS battery short-circuit protection"
	default y

config OPLUS_SHORT_HW_CHECK
	bool "OPLUS hardware battery short-circuit check"
	default y

config OPLUS_SHORT_USERSPACE
	bool "OPLUS userspace short-circuit controls"
	default y

config OPLUS_SHORT_IC_CHECK
	bool "OPLUS external short-circuit IC check"
	default y

config OPLUS_SHIP_MODE_SUPPORT
	bool "OPLUS ship mode support"
	default y

config OPLUS_CHECK_CHARGERID_VOLT
	bool "OPLUS charger-ID voltage support"
	default y

config OPLUS_RTC_DET_SUPPORT
	bool "OPLUS RTC reset detection"
	default y

config OPLUS_SMART_CHARGER_SUPPORT
	bool "OPLUS smart charger controls"
	default y

endif
```

## drivers/soc/oplus/Kconfig
```kconfig
# SPDX-License-Identifier: GPL-2.0-only
# Copyright (C) 2018-2020 Oplus. All rights reserved.

source "drivers/soc/oplus/oplus_devinfo/Kconfig"
source "drivers/soc/oplus/oplus_project/Kconfig"
source "drivers/soc/oplus/project_info/Kconfig"
source "drivers/soc/oplus/oplus_mdmrst/Kconfig"
```

## drivers/soc/oplus/oplus_devinfo/Kconfig
```kconfig
# SPDX-License-Identifier: GPL-2.0-only
# Copyright (C) 2018-2020 Oplus. All rights reserved.

config OPLUS_DEVICE_INFO
  bool "config oplus devinfo software"
  help
    define this config to compile devinfo.c for device register
```
